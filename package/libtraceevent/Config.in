## package/libtraceevent/Config.in
```kconfig
config BR2_PACKAGE_LIBTRACEEVENT
	bool "libtraceevent"

	help
	  Library to parse raw trace event formats

	  https://git.kernel.org/pub/scm/libs/libtrace/libtraceevent.git/
```

## package/libtracefs/Config.in
```kconfig
config BR2_PACKAGE_LIBTRACEFS
	bool "libtracefs"
	select BR2_PACKAGE_LIBTRACEEVENT

	help
	  Linux kernel trace file system library

	  https://git.kernel.org/pub/scm/libs/libtrace/libtracefs.git/
```

## package/libudev-zero/Config.in
```kconfig
config BR2_PACKAGE_LIBUDEV_ZERO
	bool "libudev-zero"
	depends on !BR2_PACKAGE_HAS_UDEV

	help
	  Libudev-zero is a drop-in replacement for libudev 
	  intended to work with any device manager.

	  https://github.com/illiliti/libudev-zero
```

## package/phttpd/Config.in
```kconfig
config BR2_PACKAGE_PHTTPD
	bool "phttpd"
	select BR2_PACKAGE_LIBMICROHTTPD
	help
	  phttpd implements a small http server for static content 
	  only. It can be used to supply mpd album covers. 
```

## package/pihole-ftl/Config.in
```kconfig
config BR2_PACKAGE_PIHOLE_FTL
	bool "pihole-ftl"
	depends on BR2_TOOLCHAIN_HAS_THREADS
	depends on BR2_TOOLCHAIN_HEADERS_AT_LEAST_5_10 # PR #2797
	select BR2_PACKAGE_NETTLE	# DNSSEC support
	select BR2_PACKAGE_LIBIDN2	# internationalized domain names
	select BR2_PACKAGE_LIBUNISTRING
	help
	  The Pi-hole is a DNS sinkhole that protects your devices from
	  unwanted content without installing any client-side software.

	  FTLDNS (pihole-FTL) provides an interactive API and also
	  generates statistics for Pi-hole's Web interface.

	  https://pi-hole.net

if BR2_PACKAGE_PIHOLE_FTL

config BR2_PACKAGE_PIHOLE_FTL_GRAVITY
	bool "add gravity"
	select BR2_PACKAGE_LIBCURL	# gravity list download
	select BR2_PACKAGE_LIBRESSL	# libcrypto
	help
	  "Build pihole-ftl with support for downloading blacklist files."

config BR2_PACKAGE_PIHOLE_FTL_READLINE
	bool "use readline"
	select BR2_PACKAGE_READLINE	# also supplies libhistory
	# ncurses is a dependency of readline, it supplies terminfo, which replaces libtermcap
	help
	  "Build pihole-ftl with readline support."

config BR2_PACKAGE_PIHOLE_FTL_TLS
	bool "use TLS & SSL"
	select BR2_PACKAGE_MBEDTLS
	help
	  "Enable HTTPS support for the web interface, including
	  self-generated certificates."

endif

comment "pihole-ftl needs a toolchain w/ threads"
	depends on !BR2_TOOLCHAIN_HAS_THREADS
	depends on !BR2_TOOLCHAIN_HEADERS_AT_LEAST_5_10
```

## package/pihole-web/Config.in
```kconfig
config BR2_PACKAGE_PIHOLE_WEB
	bool "pihole-web"
	depends on BR2_PACKAGE_PIHOLE_FTL
	help
	  Pi-hole's Web interface (based off of AdminLTE) provides a central
	  location to manage your Pi-hole and review the statistics generated
	  by FTLDNS.

	  https://pi-hole.net
```

## package/ravenna-alsa/Config.in
```kconfig
config BR2_PACKAGE_RAVENNA_ALSA
	bool "ravenna-alsa"
	depends on BR2_LINUX_KERNEL
	depends on !BR2_STATIC_LIBS # kmod
	help
	  Merging Technologies' implementation of a Ravenna/AES67 ALSA kernel module. 

	  https://www.merging.com/products/alsa_ravenna_aes67_driver/
```

## package/rk-brcmfmac-firmware/Config.in
```kconfig
config BR2_PACKAGE_RK_BRCMFMAC_FIRMWARE
	bool "rk-brcmfmac-firmware"
	depends on BR2_arm || BR2_aarch64
	depends on !BR2_PACKAGE_LINUX_FIRMWARE_BRCM_BCM43XXX
	help
	  Broadcom BCM43456 wifi and bluetooth module firmware 
	  and NVRAM data. 

	  https://github.com/reMarkable/brcmfmac-firmware

comment "rk-brcmfmac-firmware conflicts with linux-firmware Broadcom BRCM bcm43xx"
	depends on BR2_PACKAGE_LINUX_FIRMWARE_BRCM_BCM43XXX
```

## package/rk-firmware/Config.in
```kconfig
config BR2_PACKAGE_RK_FIRMWARE
	bool "rk-firmware"
	depends on BR2_arm || BR2_aarch64
	help
	  Rockchip Firmware for Radxa boards

	  Pre-compiled binaries of the bootloader and trusted 
	  firmware as well as tools for generating boot images

	  https://github.com/radxa/rkbin

config BR2_PACKAGE_RK_FIRMWARE_CHIP_NAME
	string "Chip name"
	default ""
	depends on BR2_PACKAGE_RK_FIRMWARE
	help
	  Specify the name of the SoC here. This string is used in selecting corresponding 
	  configurations from the package directories RKBOOT and RKTRUST, and must 
	  be UPPERCASE. 

	  Radxa Rock Pi 4 uses RK3399. 
```

## package/rtl8723bs_staging/Config.in
```kconfig
comment "r8723bs module needs a kernel to be built"
	depends on !BR2_LINUX_KERNEL

config BR2_PACKAGE_RTL8723BS
	bool "rtl8723bs"
	help
	  r8723bs is a driver for RTL8723A/B SDIO/SPI devices. 

	  https://wireless.wiki.kernel.org/en/users/drivers/rtl819x
```

## package/zita-convolver/Config.in
```kconfig
config BR2_PACKAGE_ZITA_CONVOLVER
	bool "zita-convolver"
	select BR2_PACKAGE_FFTW_DOUBLE
	help
	  zita-convolver is a C++ library imple-
	  menting a real-time convolution matrix.

	  http://kokkinizita.linuxaudio.org/linuxaudio/downloads
```
