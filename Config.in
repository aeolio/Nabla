## configs/raspberrypi3_defconfig
```kconfig
BR2_arm=y
BR2_cortex_a53=y
BR2_ARM_FPU_NEON_VFPV4=y
BR2_GLOBAL_PATCH_DIR="$(BR2_EXTERNAL_NABLA_PATH)/patches $(BR2_EXTERNAL_NABLA_PATH)/board/raspberrypi/patches"
BR2_PACKAGE_HOST_LINUX_HEADERS_CUSTOM_4_14=y
BR2_TOOLCHAIN_BUILDROOT_WCHAR=y
# BR2_UCLIBC_INSTALL_UTILS is not set
BR2_GCC_VERSION_8_X=y
BR2_TOOLCHAIN_BUILDROOT_CXX=y
BR2_GCC_ENABLE_OPENMP=y
BR2_TARGET_GENERIC_HOSTNAME="nabla"
BR2_TARGET_GENERIC_ISSUE="Welcome to the dark side"
BR2_TARGET_GENERIC_ROOT_PASSWD="nabla"
BR2_SYSTEM_DHCP="eth0"
BR2_ROOTFS_OVERLAY="$(BR2_EXTERNAL_NABLA_PATH)/skeleton $(BR2_EXTERNAL_NABLA_PATH)/board/raspberrypi/skeleton"
BR2_ROOTFS_POST_BUILD_SCRIPT="board/raspberrypi3/post-build.sh $(BR2_EXTERNAL_NABLA_PATH)/scripts/post-build.sh"
BR2_ROOTFS_POST_IMAGE_SCRIPT="board/raspberrypi3/post-image.sh"
BR2_ROOTFS_POST_SCRIPT_ARGS="--add-pi3-miniuart-bt-overlay"
BR2_LINUX_KERNEL=y
BR2_LINUX_KERNEL_CUSTOM_TARBALL=y
BR2_LINUX_KERNEL_CUSTOM_TARBALL_LOCATION="$(call github,raspberrypi,linux,rpi-4.14.y-rt)/linux-rpi-4.14.y-rt.tar.gz"
BR2_LINUX_KERNEL_DEFCONFIG="bcm2709"
BR2_LINUX_KERNEL_DTS_SUPPORT=y
BR2_LINUX_KERNEL_INTREE_DTS_NAME="bcm2710-rpi-3-b bcm2710-rpi-3-b-plus bcm2710-rpi-cm3"
BR2_PACKAGE_BUSYBOX_CONFIG_FRAGMENT_FILES="$(BR2_EXTERNAL_NABLA_PATH)/package/busybox/busybox.config"
BR2_PACKAGE_ALSA_UTILS=y
# BR2_PACKAGE_ALSA_UTILS_ALSACTL is not set
# BR2_PACKAGE_ALSA_UTILS_ALSAMIXER is not set
BR2_PACKAGE_ALSA_UTILS_AMIXER=y
BR2_PACKAGE_ALSA_UTILS_APLAY=y
BR2_PACKAGE_MPD=y
BR2_PACKAGE_MPD_LIBSAMPLERATE=y
BR2_PACKAGE_MPD_LIBSOXR=y
BR2_PACKAGE_MPD_DSD=y
BR2_PACKAGE_MPD_FLAC=y
BR2_PACKAGE_MPD_LIBSNDFILE=y
BR2_PACKAGE_MPD_LAME=y
BR2_PACKAGE_MPD_CURL=y
BR2_PACKAGE_MPD_HTTPD_OUTPUT=y
BR2_PACKAGE_MPD_NEIGHBOR_DISCOVERY_SUPPORT=y
BR2_PACKAGE_MPD_UPNP=y
BR2_PACKAGE_NCMPC=y
BR2_PACKAGE_INTERBENCH=y
BR2_PACKAGE_RT_TESTS=y
BR2_PACKAGE_CIFS_UTILS=y
BR2_PACKAGE_CURLFTPFS=y
BR2_PACKAGE_DOSFSTOOLS=y
BR2_PACKAGE_DOSFSTOOLS_FSCK_FAT=y
BR2_PACKAGE_EXFAT=y
BR2_PACKAGE_NTFS_3G=y
BR2_PACKAGE_SSHFS=y
BR2_PACKAGE_UNIONFS=y
BR2_PACKAGE_RPI_BT_FIRMWARE=y
BR2_PACKAGE_RPI_FIRMWARE=y
BR2_PACKAGE_RPI_WIFI_FIRMWARE=y
BR2_PACKAGE_LIBMAD_OPTIMIZATION_ACCURACY=y
BR2_PACKAGE_LIBSNDFILE_EXTERNAL_LIB=y
BR2_PACKAGE_LIBUSB=y
BR2_PACKAGE_LIBMICROHTTPD=y
BR2_PACKAGE_FFTW=y
BR2_PACKAGE_NCURSES_WCHAR=y
BR2_PACKAGE_CRDA=y
BR2_PACKAGE_NTP=y
BR2_PACKAGE_NTP_NTPDATE=y
BR2_PACKAGE_WPA_SUPPLICANT=y
BR2_PACKAGE_WPA_SUPPLICANT_DEBUG_SYSLOG=y
BR2_PACKAGE_UTIL_LINUX_FSCK=y
BR2_TARGET_ROOTFS_EXT2=y
BR2_TARGET_ROOTFS_EXT2_4=y
BR2_TARGET_ROOTFS_EXT2_SIZE="120M"
# BR2_TARGET_ROOTFS_TAR is not set
BR2_PACKAGE_HOST_DOSFSTOOLS=y
BR2_PACKAGE_HOST_GENIMAGE=y
BR2_PACKAGE_HOST_MTOOLS=y
```

## configs/raspberrypi_defconfig
```kconfig
BR2_aarch64=y
BR2_cortex_a72=y
BR2_TOOLCHAIN_BUILDROOT_MUSL=y
BR2_BINUTILS_VERSION_2_39_X=y
BR2_GCC_VERSION_12_X=y
BR2_TOOLCHAIN_BUILDROOT_CXX=y
BR2_GCC_ENABLE_OPENMP=y
BR2_OPTIMIZE_2=y
BR2_GLOBAL_PATCH_DIR="$(BR2_EXTERNAL_NABLA_PATH)/patches $(BR2_EXTERNAL_NABLA_PATH)/board/raspberrypi/patches"
# BR2_PIC_PIE is not set
BR2_SSP_NONE=y
BR2_RELRO_NONE=y
BR2_TARGET_GENERIC_HOSTNAME="nabla"
BR2_TARGET_GENERIC_ISSUE=""
BR2_ROOTFS_DEVICE_CREATION_DYNAMIC_MDEV=y
BR2_TARGET_GENERIC_ROOT_PASSWD="nabla"
# BR2_TARGET_GENERIC_GETTY is not set
# BR2_TARGET_GENERIC_REMOUNT_ROOTFS_RW is not set
BR2_SYSTEM_DHCP="eth0"
BR2_ROOTFS_OVERLAY="$(BR2_EXTERNAL_NABLA_PATH)/skeleton $(BR2_EXTERNAL_NABLA_PATH)/board/raspberrypi/skeleton"
BR2_ROOTFS_POST_BUILD_SCRIPT="board/raspberrypi4-64/post-build.sh $(BR2_EXTERNAL_NABLA_PATH)/scripts/post-build.sh $(BR2_EXTERNAL_NABLA_PATH)/board/raspberrypi/scripts/post-build.sh"
BR2_ROOTFS_POST_IMAGE_SCRIPT="$(BR2_EXTERNAL_NABLA_PATH)/board/raspberrypi/scripts/post-image.sh"
BR2_ROOTFS_POST_SCRIPT_ARGS="--genimage-cfg=$(BR2_EXTERNAL_NABLA_PATH)/board/raspberrypi/scripts/genimage.cfg"
BR2_LINUX_KERNEL=y
BR2_LINUX_KERNEL_CUSTOM_VERSION=y
BR2_LINUX_KERNEL_CUSTOM_VERSION_VALUE="6.1.5"
BR2_LINUX_KERNEL_PATCH="https://mirrors.edge.kernel.org/pub/linux/kernel/projects/rt/6.1/patch-6.1.5-rt7.patch.xz"
BR2_LINUX_KERNEL_USE_CUSTOM_CONFIG=y
BR2_LINUX_KERNEL_CUSTOM_CONFIG_FILE="$(BR2_EXTERNAL_NABLA_PATH)/board/raspberrypi/configs/bcm2711_defconfig"
BR2_LINUX_KERNEL_CONFIG_FRAGMENT_FILES="$(BR2_EXTERNAL_NABLA_PATH)/board/raspberrypi/configs/kernel_6.1_config.fragment"
BR2_LINUX_KERNEL_ZSTD=y
BR2_LINUX_KERNEL_DTS_SUPPORT=y
BR2_LINUX_KERNEL_INTREE_DTS_NAME="broadcom/bcm2711-rpi-4-b"
BR2_LINUX_KERNEL_NEEDS_HOST_OPENSSL=y
BR2_PACKAGE_LINUX_TOOLS_RTLA=y
BR2_PACKAGE_BUSYBOX_CONFIG_FRAGMENT_FILES="$(BR2_EXTERNAL_NABLA_PATH)/package/busybox/busybox.config"
BR2_PACKAGE_ALSA_UTILS=y
# BR2_PACKAGE_ALSA_UTILS_ALSACTL is not set
# BR2_PACKAGE_ALSA_UTILS_ALSAMIXER is not set
BR2_PACKAGE_ALSA_UTILS_AMIXER=y
BR2_PACKAGE_ALSA_UTILS_APLAY=y
# BR2_PACKAGE_FFMPEG_FFMPEG is not set
BR2_PACKAGE_FFMPEG_ENCODERS=""
BR2_PACKAGE_FFMPEG_DECODERS="alac ape mjpeg"
BR2_PACKAGE_FFMPEG_MUXERS=""
BR2_PACKAGE_FFMPEG_DEMUXERS="ape mjpeg mov"
BR2_PACKAGE_FFMPEG_PARSERS="mjpeg"
BR2_PACKAGE_FFMPEG_BSFS=""
BR2_PACKAGE_FFMPEG_PROTOCOLS="async file"
BR2_PACKAGE_FFMPEG_FILTERS=""
# BR2_PACKAGE_FFMPEG_INDEVS is not set
# BR2_PACKAGE_FFMPEG_OUTDEVS is not set
BR2_PACKAGE_MPD=y
BR2_PACKAGE_MPD_LIBSAMPLERATE=y
BR2_PACKAGE_MPD_LIBSOXR=y
BR2_PACKAGE_MPD_DSD=y
BR2_PACKAGE_MPD_FFMPEG=y
BR2_PACKAGE_MPD_FLAC=y
BR2_PACKAGE_MPD_LIBSNDFILE=y
BR2_PACKAGE_MPD_LIBNFS=y
BR2_PACKAGE_NCMPC=y
BR2_PACKAGE_COREMARK=y
BR2_PACKAGE_CIFS_UTILS=y
BR2_PACKAGE_DOSFSTOOLS=y
BR2_PACKAGE_DOSFSTOOLS_FSCK_FAT=y
BR2_PACKAGE_E2FSPROGS=y
BR2_PACKAGE_EXFAT=y
BR2_PACKAGE_NTFS_3G=y
BR2_PACKAGE_BRCMFMAC_SDIO_FIRMWARE_RPI=y
BR2_PACKAGE_BRCMFMAC_SDIO_FIRMWARE_RPI_WIFI=y
BR2_PACKAGE_RPI_FIRMWARE=y
BR2_PACKAGE_RPI_FIRMWARE_VARIANT_PI4=y
BR2_PACKAGE_RPI_FIRMWARE_CONFIG_FILE="$(BR2_EXTERNAL_NABLA_PATH)/board/raspberrypi/scripts/config.txt"
# BR2_PACKAGE_RPI_FIRMWARE_INSTALL_DTB_OVERLAYS is not set
# BR2_PACKAGE_ALSA_LIB_ALOAD is not set
# BR2_PACKAGE_ALSA_LIB_RAWMIDI is not set
# BR2_PACKAGE_ALSA_LIB_HWDEP is not set
# BR2_PACKAGE_ALSA_LIB_SEQ is not set
# BR2_PACKAGE_ALSA_LIB_UCM is not set
# BR2_PACKAGE_ALSA_LIB_ALISP is not set
# BR2_PACKAGE_ALSA_LIB_OLD_SYMBOLS is not set
# BR2_PACKAGE_ALSA_LIB_TOPOLOGY is not set
BR2_PACKAGE_LIBMAD_OPTIMIZATION_ACCURACY=y
BR2_PACKAGE_LIBRESSL=y
BR2_PACKAGE_FFTW=y
BR2_PACKAGE_ETHTOOL=y
BR2_PACKAGE_NTP=y
# BR2_PACKAGE_NTP_NTPD is not set
BR2_PACKAGE_NTP_NTPDATE=y
BR2_PACKAGE_OPENSSH=y
# BR2_PACKAGE_OPENSSH_CLIENT is not set
BR2_PACKAGE_WPA_SUPPLICANT=y
BR2_PACKAGE_WPA_SUPPLICANT_DEBUG_SYSLOG=y
BR2_TARGET_ROOTFS_CPIO=y
BR2_TARGET_ROOTFS_CPIO_GZIP=y
# BR2_TARGET_ROOTFS_TAR is not set
BR2_PACKAGE_HOST_DOSFSTOOLS=y
BR2_PACKAGE_HOST_E2FSPROGS=y
BR2_PACKAGE_HOST_GENIMAGE=y
BR2_PACKAGE_INTERBENCH=y
```

## configs/raspberrypi_nx_defconfig
```kconfig
BR2_aarch64=y
BR2_cortex_a73=y
BR2_OPTIMIZE_2=y
BR2_GLOBAL_PATCH_DIR="$(BR2_EXTERNAL_NABLA_PATH)/patches $(BR2_EXTERNAL_NABLA_PATH)/board/raspberrypi/patches"
BR2_TOOLCHAIN_BUILDROOT_MUSL=y
BR2_GCC_VERSION_10_X=y
BR2_TOOLCHAIN_BUILDROOT_CXX=y
BR2_GCC_ENABLE_OPENMP=y
BR2_TARGET_GENERIC_HOSTNAME="nabla"
BR2_TARGET_GENERIC_ISSUE="Welcome to the dark side"
BR2_ROOTFS_DEVICE_CREATION_DYNAMIC_MDEV=y
BR2_TARGET_GENERIC_ROOT_PASSWD="nabla"
# BR2_TARGET_GENERIC_GETTY is not set
# BR2_TARGET_GENERIC_REMOUNT_ROOTFS_RW is not set
BR2_SYSTEM_DHCP="eth0"
# BR2_ENABLE_LOCALE_PURGE is not set
BR2_ROOTFS_OVERLAY="$(BR2_EXTERNAL_NABLA_PATH)/skeleton $(BR2_EXTERNAL_NABLA_PATH)/board/raspberrypi/skeleton"
BR2_ROOTFS_POST_BUILD_SCRIPT="board/raspberrypi4-64/post-build.sh $(BR2_EXTERNAL_NABLA_PATH)/board/raspberrypi/scripts/post-build.sh $(BR2_EXTERNAL_NABLA_PATH)/scripts/post-build.sh"
BR2_ROOTFS_POST_IMAGE_SCRIPT="board/raspberrypi4-64/post-image.sh"
BR2_ROOTFS_POST_SCRIPT_ARGS="--aarch64 --genimage-cfg=$(BR2_EXTERNAL_NABLA_PATH)/board/raspberrypi/scripts/genimage.cfg"
BR2_LINUX_KERNEL=y
BR2_LINUX_KERNEL_CUSTOM_TARBALL=y
BR2_LINUX_KERNEL_CUSTOM_TARBALL_LOCATION="$(call github,raspberrypi,linux,rpi-5.10.y)/linux-rpi-5.10.0-rc5.tar.gz"
BR2_LINUX_KERNEL_PATCH="$(BR2_EXTERNAL_NABLA_PATH)/board/raspberrypi/patches/linux/rpi-5.10.y"
BR2_LINUX_KERNEL_USE_CUSTOM_CONFIG=y
BR2_LINUX_KERNEL_CUSTOM_CONFIG_FILE="$(BR2_EXTERNAL_NABLA_PATH)/board/raspberrypi/configs/bcm2711_nx_defconfig"
BR2_LINUX_KERNEL_ZSTD=y
BR2_LINUX_KERNEL_DTS_SUPPORT=y
BR2_LINUX_KERNEL_INTREE_DTS_NAME="broadcom/bcm2711-rpi-4-b"
BR2_LINUX_KERNEL_NEEDS_HOST_OPENSSL=y
BR2_PACKAGE_BUSYBOX_CONFIG_FRAGMENT_FILES="$(BR2_EXTERNAL_NABLA_PATH)/package/busybox/busybox.config"
BR2_PACKAGE_ALSA_UTILS=y
# BR2_PACKAGE_ALSA_UTILS_ALSACTL is not set
# BR2_PACKAGE_ALSA_UTILS_ALSAMIXER is not set
BR2_PACKAGE_ALSA_UTILS_AMIXER=y
BR2_PACKAGE_ALSA_UTILS_APLAY=y
BR2_PACKAGE_MPD=y
BR2_PACKAGE_MPD_LIBSAMPLERATE=y
BR2_PACKAGE_MPD_LIBSOXR=y
BR2_PACKAGE_MPD_DSD=y
BR2_PACKAGE_MPD_FLAC=y
BR2_PACKAGE_MPD_LIBSNDFILE=y
BR2_PACKAGE_MPD_LAME=y
BR2_PACKAGE_MPD_LIBNFS=y
BR2_PACKAGE_MPD_HTTPD_OUTPUT=y
BR2_PACKAGE_MPD_UPNP=y
BR2_PACKAGE_NCMPC=y
BR2_PACKAGE_CIFS_UTILS=y
BR2_PACKAGE_CURLFTPFS=y
BR2_PACKAGE_DOSFSTOOLS=y
BR2_PACKAGE_DOSFSTOOLS_FSCK_FAT=y
BR2_PACKAGE_E2FSPROGS=y
BR2_PACKAGE_EXFAT=y
BR2_PACKAGE_NTFS_3G=y
BR2_PACKAGE_SSHFS=y
BR2_PACKAGE_UNIONFS=y
BR2_PACKAGE_RPI_BT_FIRMWARE=y
BR2_PACKAGE_RPI_FIRMWARE=y
BR2_PACKAGE_RPI_FIRMWARE_VARIANT_PI4=y
# BR2_PACKAGE_RPI_FIRMWARE_INSTALL_DTB_OVERLAYS is not set
BR2_PACKAGE_RPI_WIFI_FIRMWARE=y
# BR2_PACKAGE_ALSA_LIB_ALOAD is not set
# BR2_PACKAGE_ALSA_LIB_RAWMIDI is not set
# BR2_PACKAGE_ALSA_LIB_HWDEP is not set
# BR2_PACKAGE_ALSA_LIB_SEQ is not set
# BR2_PACKAGE_ALSA_LIB_UCM is not set
# BR2_PACKAGE_ALSA_LIB_ALISP is not set
# BR2_PACKAGE_ALSA_LIB_OLD_SYMBOLS is not set
BR2_PACKAGE_LIBMAD_OPTIMIZATION_ACCURACY=y
BR2_PACKAGE_LIBRESSL=y
# BR2_PACKAGE_LIBCURL_PROXY_SUPPORT is not set
# BR2_PACKAGE_LIBCURL_COOKIES_SUPPORT is not set
BR2_PACKAGE_LIBCURL_TLS_NONE=y
BR2_PACKAGE_LIBMICROHTTPD=y
BR2_PACKAGE_FFTW=y
BR2_PACKAGE_NCURSES_WCHAR=y
BR2_PACKAGE_CRDA=y
BR2_PACKAGE_LIGHTTPD=y
BR2_PACKAGE_NTP=y
# BR2_PACKAGE_NTP_NTPD is not set
BR2_PACKAGE_NTP_NTPDATE=y
# BR2_PACKAGE_OPENSSH_CLIENT is not set
BR2_PACKAGE_WPA_SUPPLICANT=y
BR2_PACKAGE_WPA_SUPPLICANT_DEBUG_SYSLOG=y
BR2_TARGET_ROOTFS_CPIO=y
BR2_TARGET_ROOTFS_CPIO_GZIP=y
BR2_TARGET_ROOTFS_EXT2=y
BR2_TARGET_ROOTFS_EXT2_4=y
BR2_TARGET_ROOTFS_EXT2_LABEL="root"
BR2_TARGET_ROOTFS_EXT2_SIZE="120M"
# BR2_TARGET_ROOTFS_TAR is not set
BR2_PACKAGE_HOST_DOSFSTOOLS=y
BR2_PACKAGE_HOST_GENIMAGE=y
BR2_PACKAGE_HOST_MTOOLS=y
BR2_PACKAGE_INTERBENCH=y
```

## configs/wandboard_defconfig
```kconfig
BR2_arm=y
BR2_cortex_a9=y
BR2_ARM_ENABLE_NEON=y
BR2_GLOBAL_PATCH_DIR="$(BR2_EXTERNAL_NABLA_PATH)/patches $(BR2_EXTERNAL_NABLA_PATH)/board/wandboard/patches"
BR2_KERNEL_HEADERS_3_14=y
BR2_TOOLCHAIN_BUILDROOT_WCHAR=y
BR2_TOOLCHAIN_BUILDROOT_CXX=y
BR2_GCC_ENABLE_OPENMP=y
BR2_TARGET_GENERIC_HOSTNAME="nabla"
BR2_TARGET_GENERIC_ISSUE="Welcome to the dark side"
BR2_TARGET_GENERIC_ROOT_PASSWD="nabla"
BR2_TARGET_GENERIC_GETTY_PORT="ttymxc0"
BR2_ROOTFS_OVERLAY="$(BR2_EXTERNAL_NABLA_PATH)/board/wandboard/skeleton"
BR2_ROOTFS_POST_BUILD_SCRIPT="$(BR2_EXTERNAL_NABLA_PATH)/board/wandboard/scripts/post-build.sh"
BR2_ROOTFS_POST_IMAGE_SCRIPT="board/wandboard/post-image.sh"
BR2_LINUX_KERNEL=y
BR2_LINUX_KERNEL_CUSTOM_GIT=y
BR2_LINUX_KERNEL_CUSTOM_REPO_URL="git://github.com/wandboard-org/linux.git"
BR2_LINUX_KERNEL_CUSTOM_REPO_VERSION="wandboard_imx_3.14.28_1.0.0_ga"
BR2_LINUX_KERNEL_USE_CUSTOM_CONFIG=y
BR2_LINUX_KERNEL_CUSTOM_CONFIG_FILE="$(BR2_EXTERNAL_NABLA_PATH)/board/wandboard/config/linux.config"
BR2_LINUX_KERNEL_ZIMAGE=y
BR2_LINUX_KERNEL_DTS_SUPPORT=y
BR2_LINUX_KERNEL_INTREE_DTS_NAME="imx6q-wandboard imx6dl-wandboard"
BR2_LINUX_KERNEL_INSTALL_TARGET=y
BR2_PACKAGE_ALSA_UTILS=y
# BR2_PACKAGE_ALSA_UTILS_ALSACTL is not set
# BR2_PACKAGE_ALSA_UTILS_ALSAMIXER is not set
BR2_PACKAGE_ALSA_UTILS_AMIXER=y
BR2_PACKAGE_ALSA_UTILS_APLAY=y
BR2_PACKAGE_MPD=y
BR2_PACKAGE_MPD_LIBSAMPLERATE=y
BR2_PACKAGE_MPD_LIBSOXR=y
BR2_PACKAGE_MPD_DSD=y
BR2_PACKAGE_MPD_FFMPEG=y
BR2_PACKAGE_MPD_FLAC=y
# BR2_PACKAGE_MPD_MAD is not set
BR2_PACKAGE_MPD_CURL=y
BR2_PACKAGE_MPD_AVAHI_SUPPORT=y
BR2_PACKAGE_NCMPC=y
BR2_PACKAGE_INTERBENCH=y
BR2_PACKAGE_CIFS_UTILS=y
BR2_PACKAGE_CURLFTPFS=y
BR2_PACKAGE_EXFAT=y
BR2_PACKAGE_NTFS_3G=y
BR2_PACKAGE_SSHFS=y
BR2_PACKAGE_UNIONFS=y
BR2_PACKAGE_LINUX_FIRMWARE=y
BR2_PACKAGE_LINUX_FIRMWARE_BRCM_BCM43XX=y
BR2_PACKAGE_LIBID3TAG=y
BR2_PACKAGE_LIBUSB=y
BR2_PACKAGE_DHCPCD=y
BR2_PACKAGE_LIGHTTPD=y
BR2_PACKAGE_WPA_SUPPLICANT=y
BR2_PACKAGE_WPA_SUPPLICANT_DEBUG_SYSLOG=y
BR2_TARGET_ROOTFS_EXT2=y
BR2_TARGET_ROOTFS_EXT2_4=y
BR2_TARGET_UBOOT=y
BR2_TARGET_UBOOT_BUILD_SYSTEM_KCONFIG=y
BR2_TARGET_UBOOT_CUSTOM_GIT=y
BR2_TARGET_UBOOT_CUSTOM_REPO_URL="git://git.denx.de/u-boot.git"
BR2_TARGET_UBOOT_CUSTOM_REPO_VERSION="33711bdd4a4dce942fb5ae85a68899a8357bdd94"
BR2_TARGET_UBOOT_BOARD_DEFCONFIG="wandboard"
BR2_TARGET_UBOOT_FORMAT_CUSTOM=y
BR2_TARGET_UBOOT_FORMAT_CUSTOM_NAME="u-boot.img"
BR2_TARGET_UBOOT_SPL=y
BR2_TARGET_UBOOT_SPL_NAME="SPL"
BR2_TARGET_UBOOT_ENVIMAGE=y
BR2_TARGET_UBOOT_ENVIMAGE_SOURCE="board/wandboard/uboot-env.txt"
BR2_TARGET_UBOOT_ENVIMAGE_SIZE="0x2000"
BR2_PACKAGE_HOST_GENIMAGE=y
```

## package/aes67-daemon/Config.in
```kconfig
config BR2_PACKAGE_AES67_DAEMON
	bool "aes67-daemon"
	select BR2_PACKAGE_AVAHI
	select BR2_PACKAGE_AVAHI_DAEMON
	select BR2_PACKAGE_BOOST
	select BR2_PACKAGE_BOOST_LOG
	select BR2_PACKAGE_BOOST_PROGRAM_OPTIONS
	select BR2_PACKAGE_CPP_HTTPLIB
	select BR2_PACKAGE_RAVENNA_ALSA
	help
	  AES67 Daemon is a Linux implementation of AES67 interoperability standard 
	  used to distribute and synchronize real time audio over Ethernet.
```

## package/armbian-firmware/Config.in
```kconfig
# firmware files for RockChip /Radxa wiFi and Bluetooth
# this configuration snippet should go into buildroot package armbian-firmware

if BR2_PACKAGE_ARMBIAN_FIRMWARE

config BR2_PACKAGE_ARMBIAN_FIRMWARE_AP6256
	bool "AP6256 WiFi/BT"
	help
	  Firmware files for AP6256 WiFi/BT used in Radxa Rock Pi 4B.

endif
```

## package/brutefir/Config.in
```kconfig
config BR2_PACKAGE_BRUTEFIR
	bool "brutefir"
	select BR2_PACKAGE_FFTW_SINGLE
	select BR2_PACKAGE_FFTW_DOUBLE
	help
	  BruteFIR is a software convolution engine, a program for
	  applying long FIR filters to multi-channel digital audio,
	  either offline or in realtime.

	  https://www.torger.se/anders/brutefir.html
```

## package/cpp-httplib/Config.in
```kconfig
config BR2_PACKAGE_CPP_HTTPLIB
	bool "cpp-httplib"
	help
	  A C++11 single-file header-only cross platform HTTP/HTTPS library.

	  It's extremely easy to setup. Just include the httplib.h file in your code!

	  NOTE: This is a multi-threaded 'blocking' HTTP library. If you are looking for a 
	  'non-blocking' library, this is not the one that you want.
```

## package/esniper/Config.in
```kconfig
config BR2_PACKAGE_ESNIPER
	bool "esniper"
	depends on BR2_PACKAGE_LIBCURL
	depends on BR2_PACKAGE_LIBCURL_OPENSSL
	select BR2_PACKAGE_CA_CERTIFICATES
	help
	  esniper is a simple, lightweight tool for sniping ebay auctions. 

	  http://esniper.sourceforge.net/

comment "esniper needs libcurl w/ SSL support"
	depends on !(BR2_PACKAGE_LIBCURL && BR2_PACKAGE_LIBCURL_OPENSSL && BR2_PACKAGE_CA_CERTIFICATES)
```

## package/folve/Config.in
```kconfig
config BR2_PACKAGE_FOLVE
	bool "folve"
	select BR2_PACKAGE_FLAC
	select BR2_PACKAGE_LIBFUSE3
	select BR2_PACKAGE_LIBSNDFILE
	select BR2_PACKAGE_LIBMICROHTTPD
	select BR2_PACKAGE_ZITA_CONVOLVER

	help
	  Folve is a FUSE file system that convolves audio files on the fly.

	  https://github.com/hzeller/folve
```
