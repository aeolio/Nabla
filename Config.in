## configs/generic_x86-64_defconfig
```kconfig
BR2_x86_64=y
BR2_x86_core2=y
BR2_SVN="svn"
BR2_LUAROCKS_MIRROR="http://luarocks.org/repositories/rocks"
BR2_CPAN_MIRROR="http://search.cpan.org/CPAN"
BR2_OPTIMIZE_2=y
BR2_GLOBAL_PATCH_DIR="$(BR2_EXTERNAL_NABLA_PATH)/patches $(BR2_EXTERNAL_NABLA_PATH)/board/generic/x86-64/patches"
BR2_PACKAGE_HOST_LINUX_HEADERS_CUSTOM_5_4=y
BR2_UCLIBC_CONFIG="$(TOPDIR)/package/uclibc/uClibc-ng.config"
BR2_TOOLCHAIN_BUILDROOT_WCHAR=y
# BR2_UCLIBC_INSTALL_UTILS is not set
BR2_TOOLCHAIN_BUILDROOT_CXX=y
BR2_GCC_ENABLE_OPENMP=y
BR2_TARGET_GENERIC_HOSTNAME="nabla"
BR2_TARGET_GENERIC_ISSUE=""
BR2_ROOTFS_DEVICE_CREATION_DYNAMIC_MDEV=y
BR2_TARGET_GENERIC_ROOT_PASSWD="nabla"
BR2_TARGET_GENERIC_GETTY_PORT="tty1"
# BR2_TARGET_GENERIC_REMOUNT_ROOTFS_RW is not set
# BR2_ENABLE_LOCALE_PURGE is not set
BR2_ROOTFS_OVERLAY="$(BR2_EXTERNAL_NABLA_PATH)/skeleton $(BR2_EXTERNAL_NABLA_PATH)/board/generic/x86-64/skeleton"
BR2_ROOTFS_POST_BUILD_SCRIPT="$(BR2_EXTERNAL_NABLA_PATH)/scripts/post-build.sh"
BR2_ROOTFS_POST_IMAGE_SCRIPT="$(BR2_EXTERNAL_NABLA_PATH)/scripts/post-image.sh $(BR2_EXTERNAL_NABLA_PATH)/board/generic/i386/scripts/post-image.sh"
BR2_ROOTFS_POST_SCRIPT_ARGS="--add-config-dir --add-syslinux-cfg"
BR2_LINUX_KERNEL=y
BR2_LINUX_KERNEL_CUSTOM_VERSION=y
BR2_LINUX_KERNEL_CUSTOM_VERSION_VALUE="5.4.87"
BR2_LINUX_KERNEL_PATCH="https://www.kernel.org/pub/linux/kernel/projects/rt/5.4/patch-5.4.87-rt48.patch.gz"
BR2_LINUX_KERNEL_USE_CUSTOM_CONFIG=y
BR2_LINUX_KERNEL_CUSTOM_CONFIG_FILE="$(BR2_EXTERNAL_NABLA_PATH)/board/generic/x86-64/configs/linux_x86_64_defconfig"
BR2_LINUX_KERNEL_NEEDS_HOST_OPENSSL=y
BR2_LINUX_KERNEL_NEEDS_HOST_LIBELF=y
BR2_PACKAGE_BUSYBOX_CONFIG_FRAGMENT_FILES="$(BR2_EXTERNAL_NABLA_PATH)/package/busybox/busybox.config"
BR2_PACKAGE_ALSA_UTILS=y
# BR2_PACKAGE_ALSA_UTILS_ALSACTL is not set
# BR2_PACKAGE_ALSA_UTILS_ALSAMIXER is not set
BR2_PACKAGE_ALSA_UTILS_AMIXER=y
BR2_PACKAGE_ALSA_UTILS_APLAY=y
BR2_PACKAGE_MPD=y
BR2_PACKAGE_MPD_LIBSAMPLERATE=y
BR2_PACKAGE_MPD_LIBSOXR=y
BR2_PACKAGE_MPD_DSD=y
BR2_PACKAGE_MPD_FLAC=y
BR2_PACKAGE_MPD_LIBSNDFILE=y
BR2_PACKAGE_MPD_LIBMPDCLIENT=y
BR2_PACKAGE_MPD_UPNP=y
BR2_PACKAGE_NCMPC=y
BR2_PACKAGE_RT_TESTS=y
BR2_PACKAGE_CIFS_UTILS=y
BR2_PACKAGE_CURLFTPFS=y
BR2_PACKAGE_DOSFSTOOLS=y
BR2_PACKAGE_DOSFSTOOLS_FSCK_FAT=y
BR2_PACKAGE_E2FSPROGS=y
BR2_PACKAGE_EXFAT=y
BR2_PACKAGE_NTFS_3G=y
BR2_PACKAGE_SSHFS=y
BR2_PACKAGE_UNIONFS=y
BR2_PACKAGE_LINUX_FIRMWARE=y
BR2_PACKAGE_ACPID=y
BR2_PACKAGE_INTEL_MICROCODE=y
# BR2_PACKAGE_ALSA_LIB_ALOAD is not set
# BR2_PACKAGE_ALSA_LIB_RAWMIDI is not set
# BR2_PACKAGE_ALSA_LIB_HWDEP is not set
# BR2_PACKAGE_ALSA_LIB_SEQ is not set
# BR2_PACKAGE_ALSA_LIB_UCM is not set
# BR2_PACKAGE_ALSA_LIB_ALISP is not set
# BR2_PACKAGE_ALSA_LIB_OLD_SYMBOLS is not set
BR2_PACKAGE_LIBMAD_OPTIMIZATION_ACCURACY=y
BR2_PACKAGE_LIBRESSL=y
BR2_PACKAGE_LIBUSB=y
# BR2_PACKAGE_LIBCURL_PROXY_SUPPORT is not set
# BR2_PACKAGE_LIBCURL_COOKIES_SUPPORT is not set
BR2_PACKAGE_FFTW=y
BR2_PACKAGE_NCURSES_WCHAR=y
BR2_PACKAGE_CRDA=y
BR2_PACKAGE_LIGHTTPD=y
# BR2_PACKAGE_OPENSSH_CLIENT is not set
BR2_PACKAGE_WPA_SUPPLICANT=y
BR2_PACKAGE_WPA_SUPPLICANT_DEBUG_SYSLOG=y
BR2_PACKAGE_UTIL_LINUX_FSCK=y
BR2_TARGET_ROOTFS_INITRAMFS=y
# BR2_TARGET_ROOTFS_TAR is not set
BR2_TARGET_SYSLINUX=y
BR2_TARGET_SYSLINUX_MBR=y
BR2_TARGET_SYSLINUX_C32="ldlinux.c32"
BR2_PACKAGE_HOST_GENIMAGE=y
BR2_PACKAGE_BRUTEFIR=y
BR2_PACKAGE_FOLVE=y
BR2_PACKAGE_INTERBENCH=y
```

## configs/n100_defconfig
```kconfig
BR2_x86_64=y
BR2_x86_alderlake=y
BR2_TOOLCHAIN_BUILDROOT_UCLIBC=y
BR2_PACKAGE_HOST_LINUX_HEADERS_CUSTOM_6_9=y
BR2_UCLIBC_CONFIG="$(TOPDIR)/package/uclibc/uClibc-ng.config"
BR2_TOOLCHAIN_BUILDROOT_WCHAR=y
# BR2_UCLIBC_INSTALL_UTILS is not set
BR2_BINUTILS_VERSION_2_42_X=y
BR2_GCC_VERSION_14_X=y
BR2_TOOLCHAIN_BUILDROOT_CXX=y
BR2_GLOBAL_PATCH_DIR="$(BR2_EXTERNAL_NABLA_PATH)/patches $(BR2_EXTERNAL_NABLA_PATH)/board/generic/x86_64/patches"
# BR2_PIC_PIE is not set
BR2_RELRO_NONE=y
BR2_TARGET_GENERIC_HOSTNAME="nabla"
BR2_TARGET_GENERIC_ISSUE=""
BR2_ROOTFS_DEVICE_CREATION_DYNAMIC_MDEV=y
BR2_TARGET_GENERIC_ROOT_PASSWD="nabla"
BR2_TARGET_GENERIC_GETTY_PORT="tty1"
# BR2_TARGET_GENERIC_REMOUNT_ROOTFS_RW is not set
BR2_ROOTFS_OVERLAY="$(BR2_EXTERNAL_NABLA_PATH)/skeleton $(BR2_EXTERNAL_NABLA_PATH)/board/generic/x86_64/skeleton"
BR2_ROOTFS_POST_BUILD_SCRIPT="$(BR2_EXTERNAL_NABLA_PATH)/scripts/post-build.sh"
BR2_ROOTFS_POST_IMAGE_SCRIPT="$(BR2_EXTERNAL_NABLA_PATH)/board/generic/x86_64/scripts/post-image.sh $(BR2_EXTERNAL_NABLA_PATH)/scripts/post-image.sh"
BR2_ROOTFS_POST_SCRIPT_ARGS="--add-config-dir --add-syslinux-cfg"
BR2_LINUX_KERNEL=y
BR2_LINUX_KERNEL_CUSTOM_VERSION=y
BR2_LINUX_KERNEL_CUSTOM_VERSION_VALUE="6.9"
BR2_LINUX_KERNEL_PATCH="https://mirrors.edge.kernel.org/pub/linux/kernel/projects/rt/6.9/patch-6.9-rt5.patch.xz"
BR2_LINUX_KERNEL_USE_CUSTOM_CONFIG=y
BR2_LINUX_KERNEL_CUSTOM_CONFIG_FILE="$(BR2_EXTERNAL_NABLA_PATH)/board/generic/x86_64/configs/intel_x86_64_defconfig"
BR2_LINUX_KERNEL_CONFIG_FRAGMENT_FILES="$(BR2_EXTERNAL_NABLA_PATH)/board/generic/x86_64/configs/kernel_6.1_config.fragment $(BR2_EXTERNAL_NABLA_PATH)/board/generic/x86_64/configs/kernel_6.6_config.fragment"
BR2_LINUX_KERNEL_ZSTD=y
BR2_LINUX_KERNEL_NEEDS_HOST_OPENSSL=y
BR2_LINUX_KERNEL_NEEDS_HOST_LIBELF=y
BR2_PACKAGE_BUSYBOX_CONFIG="package/busybox/busybox-minimal.config"
BR2_PACKAGE_BUSYBOX_CONFIG_FRAGMENT_FILES="$(BR2_EXTERNAL_NABLA_PATH)/package/busybox/busybox.fragment"
BR2_PACKAGE_ALSA_UTILS=y
# BR2_PACKAGE_ALSA_UTILS_ALSACTL is not set
# BR2_PACKAGE_ALSA_UTILS_ALSAMIXER is not set
BR2_PACKAGE_ALSA_UTILS_AMIXER=y
BR2_PACKAGE_ALSA_UTILS_APLAY=y
# BR2_PACKAGE_FFMPEG_FFMPEG is not set
BR2_PACKAGE_FFMPEG_ENCODERS=""
BR2_PACKAGE_FFMPEG_DECODERS="aac alac ape flac"
BR2_PACKAGE_FFMPEG_MUXERS=""
BR2_PACKAGE_FFMPEG_DEMUXERS="ape mov ogg"
BR2_PACKAGE_FFMPEG_PARSERS=""
BR2_PACKAGE_FFMPEG_BSFS=""
BR2_PACKAGE_FFMPEG_PROTOCOLS="async file http"
BR2_PACKAGE_FFMPEG_FILTERS=""
# BR2_PACKAGE_FFMPEG_INDEVS is not set
# BR2_PACKAGE_FFMPEG_OUTDEVS is not set
BR2_PACKAGE_MPD=y
BR2_PACKAGE_MPD_LIBSAMPLERATE=y
BR2_PACKAGE_MPD_LIBSOXR=y
BR2_PACKAGE_MPD_DSD=y
BR2_PACKAGE_MPD_FFMPEG=y
BR2_PACKAGE_MPD_FLAC=y
BR2_PACKAGE_MPD_LIBSNDFILE=y
# BR2_PACKAGE_MPD_MAD is not set
BR2_PACKAGE_MPD_MPG123=y
BR2_PACKAGE_NCMPC=y
BR2_PACKAGE_COREMARK=y
BR2_PACKAGE_RT_TESTS=y
BR2_PACKAGE_DOSFSTOOLS=y
BR2_PACKAGE_DOSFSTOOLS_FSCK_FAT=y
BR2_PACKAGE_E2FSPROGS=y
BR2_PACKAGE_EXFAT=y
BR2_PACKAGE_NFS_UTILS=y
BR2_PACKAGE_LINUX_FIRMWARE=y
BR2_PACKAGE_ACPID=y
BR2_PACKAGE_INTEL_MICROCODE=y
# BR2_PACKAGE_ALSA_LIB_ALOAD is not set
# BR2_PACKAGE_ALSA_LIB_RAWMIDI is not set
# BR2_PACKAGE_ALSA_LIB_HWDEP is not set
# BR2_PACKAGE_ALSA_LIB_SEQ is not set
# BR2_PACKAGE_ALSA_LIB_UCM is not set
# BR2_PACKAGE_ALSA_LIB_ALISP is not set
# BR2_PACKAGE_ALSA_LIB_OLD_SYMBOLS is not set
# BR2_PACKAGE_ALSA_LIB_TOPOLOGY is not set
BR2_PACKAGE_LIBRESSL=y
BR2_PACKAGE_ETHTOOL=y
BR2_PACKAGE_OPENSSH=y
# BR2_PACKAGE_OPENSSH_CLIENT is not set
BR2_PACKAGE_WPA_SUPPLICANT=y
BR2_PACKAGE_WPA_SUPPLICANT_DEBUG_SYSLOG=y
BR2_PACKAGE_UTIL_LINUX_FSCK=y
BR2_TARGET_ROOTFS_INITRAMFS=y
# BR2_TARGET_ROOTFS_TAR is not set
BR2_TARGET_SYSLINUX=y
BR2_TARGET_SYSLINUX_MBR=y
BR2_TARGET_SYSLINUX_C32="ldlinux.c32"
BR2_PACKAGE_INTERBENCH=y
```

## configs/radxa_rockpi4_defconfig
```kconfig
BR2_aarch64=y
BR2_cortex_a72_a53=y
BR2_OPTIMIZE_FAST=y
BR2_GLOBAL_PATCH_DIR="$(BR2_EXTERNAL_NABLA_PATH)/patches $(BR2_EXTERNAL_NABLA_PATH)/board/radxa/rockpi4/patches"
BR2_TOOLCHAIN_BUILDROOT_MUSL=y
BR2_BINUTILS_VERSION_2_31_X=y
BR2_TOOLCHAIN_BUILDROOT_CXX=y
BR2_GCC_ENABLE_OPENMP=y
BR2_TARGET_GENERIC_HOSTNAME="nabla"
BR2_TARGET_GENERIC_ISSUE="Welcome to the dark side"
BR2_ROOTFS_DEVICE_CREATION_DYNAMIC_MDEV=y
BR2_TARGET_GENERIC_ROOT_PASSWD="nabla"
BR2_TARGET_GENERIC_GETTY_PORT="ttyS2"
BR2_ROOTFS_OVERLAY="$(BR2_EXTERNAL_NABLA_PATH)/skeleton $(BR2_EXTERNAL_NABLA_PATH)/board/radxa/rockpi4/skeleton"
BR2_ROOTFS_POST_BUILD_SCRIPT="$(BR2_EXTERNAL_NABLA_PATH)/scripts/post-build.sh $(BR2_EXTERNAL_NABLA_PATH)/board/radxa/rockpi4/scripts/post-build.sh"
BR2_ROOTFS_POST_IMAGE_SCRIPT="$(BR2_EXTERNAL_NABLA_PATH)/board/radxa/rockpi4/scripts/post-image.sh"
BR2_ROOTFS_POST_SCRIPT_ARGS="--aarch64"
BR2_LINUX_KERNEL=y
BR2_LINUX_KERNEL_CUSTOM_VERSION=y
BR2_LINUX_KERNEL_CUSTOM_VERSION_VALUE="5.4.10"
BR2_LINUX_KERNEL_PATCH="https://mirrors.edge.kernel.org/pub/linux/kernel/projects/rt/5.4/patch-5.4.10-rt5.patch.gz"
BR2_LINUX_KERNEL_USE_CUSTOM_CONFIG=y
BR2_LINUX_KERNEL_CUSTOM_CONFIG_FILE="$(BR2_EXTERNAL_NABLA_PATH)/board/radxa/rockpi4/configs/linux.config"
BR2_LINUX_KERNEL_DTS_SUPPORT=y
BR2_LINUX_KERNEL_INTREE_DTS_NAME="rockchip/rk3399-rock-pi-4"
BR2_LINUX_KERNEL_DTB_OVERLAY_SUPPORT=y
BR2_LINUX_KERNEL_NEEDS_HOST_OPENSSL=y
BR2_PACKAGE_BUSYBOX_CONFIG_FRAGMENT_FILES="$(BR2_EXTERNAL_NABLA_PATH)/package/busybox/busybox.config"
BR2_PACKAGE_ALSA_UTILS=y
# BR2_PACKAGE_ALSA_UTILS_ALSACTL is not set
# BR2_PACKAGE_ALSA_UTILS_ALSAMIXER is not set
BR2_PACKAGE_ALSA_UTILS_AMIXER=y
BR2_PACKAGE_ALSA_UTILS_APLAY=y
BR2_PACKAGE_LAME=y
BR2_PACKAGE_MPD=y
BR2_PACKAGE_MPD_LIBSAMPLERATE=y
BR2_PACKAGE_MPD_LIBSOXR=y
BR2_PACKAGE_MPD_DSD=y
BR2_PACKAGE_MPD_FLAC=y
BR2_PACKAGE_MPD_LIBSNDFILE=y
BR2_PACKAGE_MPD_HTTPD_OUTPUT=y
BR2_PACKAGE_MPD_NEIGHBOR_DISCOVERY_SUPPORT=y
BR2_PACKAGE_MPD_UPNP=y
BR2_PACKAGE_NCMPC=y
BR2_PACKAGE_INTERBENCH=y
BR2_PACKAGE_CIFS_UTILS=y
BR2_PACKAGE_CURLFTPFS=y
BR2_PACKAGE_DOSFSTOOLS=y
BR2_PACKAGE_DOSFSTOOLS_FSCK_FAT=y
BR2_PACKAGE_EXFAT=y
BR2_PACKAGE_NTFS_3G=y
BR2_PACKAGE_SSHFS=y
BR2_PACKAGE_UNIONFS=y
BR2_PACKAGE_ARMBIAN_FIRMWARE=y
BR2_PACKAGE_LIBMAD_OPTIMIZATION_ACCURACY=y
BR2_PACKAGE_LIBSNDFILE_EXTERNAL_LIB=y
BR2_PACKAGE_LIBUSB=y
BR2_PACKAGE_LIBMICROHTTPD=y
BR2_PACKAGE_FFTW=y
BR2_PACKAGE_NCURSES_WCHAR=y
BR2_PACKAGE_CRDA=y
BR2_PACKAGE_WPA_SUPPLICANT=y
BR2_PACKAGE_WPA_SUPPLICANT_DEBUG_SYSLOG=y
BR2_PACKAGE_UTIL_LINUX=y
BR2_PACKAGE_UTIL_LINUX_FSCK=y
BR2_TARGET_ROOTFS_CPIO_GZIP=y
BR2_TARGET_ROOTFS_INITRAMFS=y
# BR2_TARGET_ROOTFS_TAR is not set
BR2_TARGET_UBOOT=y
BR2_TARGET_UBOOT_BOARD_DEFCONFIG="rock-pi-4-rk3399"
BR2_TARGET_UBOOT_NEEDS_DTC=y
# BR2_TARGET_UBOOT_FORMAT_BIN is not set
BR2_TARGET_UBOOT_FORMAT_DTB_BIN=y
BR2_PACKAGE_HOST_DOSFSTOOLS=y
BR2_PACKAGE_HOST_E2FSPROGS=y
BR2_PACKAGE_HOST_GENIMAGE=y
BR2_PACKAGE_HOST_MTOOLS=y
BR2_PACKAGE_HOST_UBOOT_TOOLS=y
BR2_PACKAGE_RK_FIRMWARE=y
BR2_PACKAGE_RK_FIRMWARE_CHIP_NAME="RK3399"
BR2_PACKAGE_ARMBIAN_FIRMWARE_AP6256=y
```

## configs/raspberrypi3_64_defconfig
```kconfig
BR2_aarch64=y
BR2_ARM_FPU_VFPV4=y
BR2_OPTIMIZE_2=y
BR2_GLOBAL_PATCH_DIR="$(BR2_EXTERNAL_NABLA_PATH)/patches $(BR2_EXTERNAL_NABLA_PATH)/board/raspberrypi/patches"
BR2_TOOLCHAIN_BUILDROOT_MUSL=y
BR2_PACKAGE_HOST_LINUX_HEADERS_CUSTOM_4_9=y
BR2_TOOLCHAIN_BUILDROOT_CXX=y
BR2_GCC_ENABLE_OPENMP=y
BR2_TARGET_GENERIC_HOSTNAME="nabla"
BR2_TARGET_GENERIC_ISSUE="Welcome to the dark side"
BR2_ROOTFS_DEVICE_CREATION_DYNAMIC_MDEV=y
BR2_TARGET_GENERIC_ROOT_PASSWD="nabla"
BR2_TARGET_GENERIC_GETTY_PORT="ttyAMA0"
BR2_TARGET_GENERIC_GETTY_BAUDRATE_115200=y
BR2_SYSTEM_DHCP="eth0"
BR2_ROOTFS_OVERLAY="$(BR2_EXTERNAL_NABLA_PATH)/skeleton $(BR2_EXTERNAL_NABLA_PATH)/board/raspberrypi/skeleton"
BR2_ROOTFS_POST_BUILD_SCRIPT="$(TOPDIR)/board/raspberrypi3-64/post-build.sh $(BR2_EXTERNAL_NABLA_PATH)/scripts/post-build.sh $(BR2_EXTERNAL_NABLA_PATH)/board/raspberrypi/scripts/post-build.sh"
BR2_ROOTFS_POST_IMAGE_SCRIPT="$(TOPDIR)/board/raspberrypi3-64/post-image.sh $(BR2_EXTERNAL_NABLA_PATH)/scripts/post-image.sh"
BR2_ROOTFS_POST_SCRIPT_ARGS="--aarch64 --genimage-cfg=$(BR2_EXTERNAL_NABLA_PATH)/board/raspberrypi/scripts/genimage.cfg"
BR2_LINUX_KERNEL=y
BR2_LINUX_KERNEL_CUSTOM_GIT=y
BR2_LINUX_KERNEL_CUSTOM_REPO_URL="https://github.com/raspberrypi/linux.git"
BR2_LINUX_KERNEL_CUSTOM_REPO_VERSION="rpi-4.9.y"
BR2_LINUX_KERNEL_USE_CUSTOM_CONFIG=y
BR2_LINUX_KERNEL_CUSTOM_CONFIG_FILE="$(BR2_EXTERNAL_NABLA_PATH)/board/raspberrypi/configs/bcm2710_64_defconfig"
BR2_LINUX_KERNEL_DTS_SUPPORT=y
BR2_LINUX_KERNEL_INTREE_DTS_NAME="broadcom/bcm2710-rpi-3-b broadcom/bcm2710-rpi-3-b-plus broadcom/bcm2837-rpi-3-b"
BR2_PACKAGE_BUSYBOX_CONFIG_FRAGMENT_FILES="$(BR2_EXTERNAL_NABLA_PATH)/package/busybox/busybox.config"
BR2_PACKAGE_ALSA_UTILS=y
# BR2_PACKAGE_ALSA_UTILS_ALSACTL is not set
# BR2_PACKAGE_ALSA_UTILS_ALSAMIXER is not set
BR2_PACKAGE_ALSA_UTILS_AMIXER=y
BR2_PACKAGE_ALSA_UTILS_APLAY=y
BR2_PACKAGE_FFMPEG=y
# BR2_PACKAGE_FFMPEG_FFMPEG is not set
BR2_PACKAGE_MPD=y
BR2_PACKAGE_MPD_LIBSAMPLERATE=y
BR2_PACKAGE_MPD_LIBSOXR=y
BR2_PACKAGE_MPD_DSD=y
BR2_PACKAGE_MPD_FLAC=y
BR2_PACKAGE_MPD_LIBSNDFILE=y
BR2_PACKAGE_MPD_CURL=y
BR2_PACKAGE_MPD_NEIGHBOR_DISCOVERY_SUPPORT=y
BR2_PACKAGE_MPD_UPNP=y
BR2_PACKAGE_NCMPC=y
BR2_PACKAGE_INTERBENCH=y
BR2_PACKAGE_CIFS_UTILS=y
BR2_PACKAGE_CURLFTPFS=y
BR2_PACKAGE_DOSFSTOOLS=y
BR2_PACKAGE_DOSFSTOOLS_FSCK_FAT=y
BR2_PACKAGE_E2FSPROGS=y
BR2_PACKAGE_EXFAT=y
BR2_PACKAGE_NTFS_3G=y
BR2_PACKAGE_SSHFS=y
BR2_PACKAGE_UNIONFS=y
BR2_PACKAGE_RPI_BT_FIRMWARE=y
BR2_PACKAGE_RPI_FIRMWARE=y
BR2_PACKAGE_RPI_WIFI_FIRMWARE=y
BR2_PACKAGE_LIBMAD_OPTIMIZATION_ACCURACY=y
BR2_PACKAGE_LIBSNDFILE_EXTERNAL_LIB=y
BR2_PACKAGE_LIBUSB=y
BR2_PACKAGE_LIBMICROHTTPD=y
BR2_PACKAGE_FFTW=y
BR2_PACKAGE_CRDA=y
BR2_PACKAGE_LIGHTTPD=y
BR2_PACKAGE_WPA_SUPPLICANT=y
BR2_PACKAGE_UTIL_LINUX_FSCK=y
BR2_TARGET_ROOTFS_CPIO=y
BR2_TARGET_ROOTFS_CPIO_GZIP=y
BR2_TARGET_ROOTFS_EXT2=y
BR2_TARGET_ROOTFS_EXT2_4=y
BR2_TARGET_ROOTFS_EXT2_LABEL="root"
BR2_TARGET_ROOTFS_EXT2_SIZE="64M"
# BR2_TARGET_ROOTFS_TAR is not set
BR2_PACKAGE_HOST_DOSFSTOOLS=y
BR2_PACKAGE_HOST_E2TOOLS=y
BR2_PACKAGE_HOST_GENIMAGE=y
BR2_PACKAGE_HOST_MTOOLS=y
```
