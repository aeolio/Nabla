## Config.in
```kconfig
#
# Linux version definition
#

source "$BR2_EXTERNAL_NABLA_PATH/Config.in.linux"


#
# presets for standard configurations
#

# for client connectivity, mpd needs tcp sockets
config BR2_PACKAGE_MPD_SOCKETS
	bool
	default y if BR2_PACKAGE_MPD
	select BR2_PACKAGE_MPD_TCP

# for mpd server, enable NFS server functionality
config BR2_PACKAGE_MPD_NFS_UTILS
	bool
	default y if NABLA_SERVER
	select BR2_PACKAGE_NFS_UTILS
	select BR2_PACKAGE_NFS_UTILS_RPC_NFSD

# for libmad, prefer accuracy over speed
#	this does not work, unfortunately;
#	choice item needs to be set manually
# use architecture-specific optimizations
config BR2_PACKAGE_LIBMAD_DEFAULTS
	bool
	default y if BR2_PACKAGE_LIBMAD
	select BR2_PACKAGE_LIBMAD_OPTIMIZATION_ACCURACY
	select BR2_PACKAGE_LIBMAD_ASO

# alsaloop depends on libsamplerate
config BR2_PACKAGE_ALSA_UTILS_ALSALOOP_DEFAULTS
	bool
	default y if BR2_PACKAGE_ALSA_UTILS_ALSALOOP
	select BR2_PACKAGE_LIBSAMPLERATE

# wpa-supplicant needs wireless-regdb
config BR2_PACKAGE_WPA_SUPPLICANT_WIRELESS_REGDB
	bool
	default y if BR2_PACKAGE_WPA_SUPPLICANT && !BR2_STATIC_LIBS
	select BR2_PACKAGE_WIRELESS_REGDB

# post-image-script needs host-genimage
config BR2_ROOTFS_POST_IMAGE_SCRIPT_GENIMAGE
	bool
	default y if BR2_ROOTFS_POST_IMAGE_SCRIPT != ""
	select BR2_PACKAGE_HOST_GENIMAGE

# host-genimage needs host-mtools
config BR2_PACKAGE_HOST_GENIMAGE_MTOOLS
	bool
	default y if BR2_PACKAGE_HOST_GENIMAGE
	select BR2_PACKAGE_HOST_MTOOLS

# Disable write-through for SQL databases
config BR2_PACKAGE_SQLITE_WRITE_BACK
	bool
	default y if BR2_PACKAGE_SQLITE
	select BR2_PACKAGE_SQLITE_NO_SYNC

# Should ncurses use wide characters if enabled in Toolchain menu?
config BR2_PACKAGE_NCURSES_WIDE
	bool
	default y if BR2_PACKAGE_NCURSES && BR2_USE_WCHAR
	select BR2_PACKAGE_NCURSES_WCHAR

# libcurl needs ca-certificates for ssl connections
config BR2_PACKAGE_LIBCURL_CA_CERTIFICATES
	bool
	default y if BR2_PACKAGE_LIBCURL
	select BR2_PACKAGE_CA_CERTIFICATES

# for libcurl enable zlib support (probably already included)
config BR2_PACKAGE_LIBCURL_ZLIB
	bool
	default y if BR2_PACKAGE_LIBCURL
	select BR2_PACKAGE_ZLIB


#
# external options menu
#

# mpd server needs BR2_PACKAGE_MPD_MPG123 to extract mp3 meta data
# mpd client uses BR2_PACKAGE_MPD_MAD for playback and
# BR2_PACKAGE_MPD_LIBNFS for remote database access
# mpd standalone needs both BR2_PACKAGE_MPD_MPG123 and BR2_PACKAGE_MPD_MAD
# both server and standalone can use liburing for async access to local files
# playback functionality requires alsa

# introduce 'unconfigured' option to avoid errors during test builds

comment "main system configuration"
choice
	prompt "Machine type"
	default NABLA_UNCONFIGURED
	help
	  Enable standard features to configure a system as
	  client /server /standalone music player.

config NABLA_UNCONFIGURED
	bool "unconfigured"
	help
	  No music player software will be included in the build.

config NABLA_CLIENT
	bool "client"
	select BR2_PACKAGE_MPD_ALSA		# local playback
	select BR2_PACKAGE_MPD_LIBMPDCLIENT
	select BR2_PACKAGE_MPD_MAD		# mp3 playback
	select BR2_PACKAGE_MPD_LIBNFS	# remote database access
	help
	  A client machine accesses a remote database
	  and plays music locally.

config NABLA_SERVER
	bool "server"
	select BR2_PACKAGE_MPD_MPG123	# mp3 meta data extraction
	# io_uring causes high io activity with Linux versions < 6.15
	# select BR2_PACKAGE_MPD_IO_URING	# async access to local files
	help
	  A server machine manages a local database
	  and is not used to play music.

config NABLA_STANDALONE
	bool "standalone"
	select BR2_PACKAGE_MPD_ALSA		# local playback
	select BR2_PACKAGE_MPD_LIBMPDCLIENT
	select BR2_PACKAGE_MPD_MPG123	# mp3 meta data extraction
	select BR2_PACKAGE_MPD_MAD		# mp3 playback
	# io_uring causes high io activity with Linux versions < 6.15
	# select BR2_PACKAGE_MPD_IO_URING	# async access to local files
	help
	  A standalone machine has both a local database
	  and local playback capability

endchoice # Machine type

comment "additional packages"
menu "Audio and video applications"
source "$BR2_EXTERNAL_NABLA_PATH/package/brutefir/Config.in"
source "$BR2_EXTERNAL_NABLA_PATH/package/folve/Config.in"
source "$BR2_EXTERNAL_NABLA_PATH/package/zita-convolver/Config.in"
endmenu

menu "Debugging, profiling and benchmark"
source "$BR2_EXTERNAL_NABLA_PATH/package/interbench/Config.in"
endmenu

if BR2_arm || BR2_aarch64

menu "Hardware handling"
menu "Firmware"
source "$BR2_EXTERNAL_NABLA_PATH/package/armbian-firmware/Config.in"
source "$BR2_EXTERNAL_NABLA_PATH/package/rk-firmware/Config.in"
endmenu
endmenu

endif # BR2_arm || BR2_aarch64

menu "Networking applications"
source "$BR2_EXTERNAL_NABLA_PATH/package/pihole-ftl/Config.in"
source "$BR2_EXTERNAL_NABLA_PATH/package/pihole-web/Config.in"
endmenu
```

## board/generic/x86-64/configs/linux_x86_64_defconfig
```kconfig
# CONFIG_LOCALVERSION_AUTO is not set
CONFIG_DEFAULT_HOSTNAME="nabla"
# CONFIG_SWAP is not set
CONFIG_SYSVIPC=y
CONFIG_POSIX_MQUEUE=y
CONFIG_NO_HZ_IDLE=y
CONFIG_HIGH_RES_TIMERS=y
CONFIG_PREEMPT_RT=y
CONFIG_BLK_DEV_INITRD=y
CONFIG_INITRAMFS_SOURCE="${BR_BINARIES_DIR}/rootfs.cpio"
# CONFIG_RD_BZIP2 is not set
# CONFIG_RD_LZMA is not set
# CONFIG_RD_XZ is not set
# CONFIG_RD_LZO is not set
# CONFIG_RD_LZ4 is not set
# CONFIG_SGETMASK_SYSCALL is not set
# CONFIG_SYSFS_SYSCALL is not set
# CONFIG_PCSPKR_PLATFORM is not set
# CONFIG_KALLSYMS is not set
CONFIG_EMBEDDED=y
# CONFIG_SLUB_DEBUG is not set
# CONFIG_COMPAT_BRK is not set
CONFIG_SMP=y
# CONFIG_X86_MPPARSE is not set
# CONFIG_X86_EXTENDED_PLATFORM is not set
CONFIG_MCORE2=y
CONFIG_NR_CPUS=4
CONFIG_X86_REROUTE_FOR_BROKEN_BOOT_IRQS=y
# CONFIG_X86_MCE is not set
# CONFIG_X86_16BIT is not set
# CONFIG_X86_VSYSCALL_EMULATION is not set
CONFIG_MICROCODE_AMD=y
CONFIG_X86_MSR=y
CONFIG_X86_CPUID=y
CONFIG_NUMA=y
# CONFIG_AMD_NUMA is not set
CONFIG_NODES_SHIFT=4
CONFIG_EFI=y
# CONFIG_SECCOMP is not set
CONFIG_HZ_100=y
CONFIG_KEXEC=y
CONFIG_KEXEC_FILE=y
# CONFIG_SUSPEND is not set
# CONFIG_ACPI_AC is not set
# CONFIG_ACPI_BATTERY is not set
# CONFIG_ACPI_FAN is not set
CONFIG_ACPI_PROCESSOR_AGGREGATOR=y
CONFIG_PMIC_OPREGION=y
CONFIG_CPU_FREQ_GOV_POWERSAVE=y
CONFIG_X86_PCC_CPUFREQ=y
CONFIG_X86_ACPI_CPUFREQ=y
# CONFIG_X86_ACPI_CPUFREQ_CPB is not set
CONFIG_INTEL_IDLE=y
# CONFIG_ISA_DMA_API is not set
CONFIG_X86_SYSFB=y
# CONFIG_FIRMWARE_MEMMAP is not set
# CONFIG_DMIID is not set
CONFIG_EFI_VARS=y
# CONFIG_VIRTUALIZATION is not set
CONFIG_MODULES=y
CONFIG_MODULE_UNLOAD=y
# CONFIG_UNUSED_SYMBOLS is not set
CONFIG_PARTITION_ADVANCED=y
CONFIG_LDM_PARTITION=y
# CONFIG_MQ_IOSCHED_KYBER is not set
CONFIG_NET=y
CONFIG_PACKET=y
CONFIG_UNIX=y
CONFIG_INET=y
# CONFIG_INET_DIAG is not set
CONFIG_IPV6_SIT=m
CONFIG_BT=m
CONFIG_BT_LEDS=y
CONFIG_CFG80211=m
CONFIG_CFG80211_WEXT=y
CONFIG_MAC80211=m
CONFIG_MAC80211_MESH=y
CONFIG_PCI=y
CONFIG_PCIEPORTBUS=y
CONFIG_PCI_MSI=y
CONFIG_UEVENT_HELPER=y
CONFIG_UEVENT_HELPER_PATH="/sbin/hotplug"
CONFIG_DEVTMPFS=y
CONFIG_DEVTMPFS_MOUNT=y
CONFIG_CONNECTOR=y
# CONFIG_PNP_DEBUG_MESSAGES is not set
CONFIG_BLK_DEV_LOOP=y
CONFIG_BLK_DEV_RAM=y
CONFIG_EEPROM_93CX6=y
CONFIG_SCSI=y
# CONFIG_SCSI_PROC_FS is not set
CONFIG_BLK_DEV_SD=y
CONFIG_CHR_DEV_SG=y
CONFIG_SCSI_SCAN_ASYNC=y
CONFIG_SCSI_SPI_ATTRS=y
# CONFIG_SCSI_LOWLEVEL is not set
CONFIG_ATA=m
CONFIG_SATA_AHCI=m
CONFIG_SATA_AHCI_PLATFORM=m
CONFIG_NETDEVICES=y
# CONFIG_NET_VENDOR_3COM is not set
# CONFIG_NET_VENDOR_ADAPTEC is not set
# CONFIG_NET_VENDOR_AGERE is not set
# CONFIG_NET_VENDOR_ALACRITECH is not set
# CONFIG_NET_VENDOR_ALTEON is not set
# CONFIG_NET_VENDOR_AMAZON is not set
# CONFIG_NET_VENDOR_AMD is not set
# CONFIG_NET_VENDOR_AQUANTIA is not set
# CONFIG_NET_VENDOR_ARC is not set
# CONFIG_NET_VENDOR_ATHEROS is not set
# CONFIG_NET_VENDOR_AURORA is not set
# CONFIG_NET_VENDOR_BROADCOM is not set
# CONFIG_NET_VENDOR_BROCADE is not set
# CONFIG_NET_VENDOR_CADENCE is not set
# CONFIG_NET_VENDOR_CAVIUM is not set
# CONFIG_NET_VENDOR_CHELSIO is not set
# CONFIG_NET_VENDOR_CISCO is not set
# CONFIG_NET_VENDOR_CORTINA is not set
# CONFIG_NET_VENDOR_DEC is not set
# CONFIG_NET_VENDOR_DLINK is not set
# CONFIG_NET_VENDOR_EMULEX is not set
# CONFIG_NET_VENDOR_EZCHIP is not set
# CONFIG_NET_VENDOR_GOOGLE is not set
# CONFIG_NET_VENDOR_HP is not set
# CONFIG_NET_VENDOR_HUAWEI is not set
# CONFIG_NET_VENDOR_I825XX is not set
CONFIG_E1000=m
CONFIG_E1000E=m
CONFIG_SKY2=m
# CONFIG_NET_VENDOR_MELLANOX is not set
# CONFIG_NET_VENDOR_MICREL is not set
# CONFIG_NET_VENDOR_MICROCHIP is not set
# CONFIG_NET_VENDOR_MICROSEMI is not set
# CONFIG_NET_VENDOR_MYRI is not set
# CONFIG_NET_VENDOR_NATSEMI is not set
# CONFIG_NET_VENDOR_NETERION is not set
# CONFIG_NET_VENDOR_NETRONOME is not set
# CONFIG_NET_VENDOR_NI is not set
# CONFIG_NET_VENDOR_NVIDIA is not set
# CONFIG_NET_VENDOR_OKI is not set
# CONFIG_NET_VENDOR_PACKET_ENGINES is not set
# CONFIG_NET_VENDOR_PENSANDO is not set
# CONFIG_NET_VENDOR_QLOGIC is not set
# CONFIG_NET_VENDOR_QUALCOMM is not set
# CONFIG_NET_VENDOR_RDC is not set
CONFIG_R8169=m
# CONFIG_NET_VENDOR_RENESAS is not set
# CONFIG_NET_VENDOR_ROCKER is not set
# CONFIG_NET_VENDOR_SAMSUNG is not set
# CONFIG_NET_VENDOR_SEEQ is not set
# CONFIG_NET_VENDOR_SOLARFLARE is not set
# CONFIG_NET_VENDOR_SILAN is not set
# CONFIG_NET_VENDOR_SIS is not set
# CONFIG_NET_VENDOR_SMSC is not set
# CONFIG_NET_VENDOR_SOCIONEXT is not set
# CONFIG_NET_VENDOR_STMICRO is not set
# CONFIG_NET_VENDOR_SUN is not set
# CONFIG_NET_VENDOR_SYNOPSYS is not set
# CONFIG_NET_VENDOR_TEHUTI is not set
# CONFIG_NET_VENDOR_TI is not set
# CONFIG_NET_VENDOR_VIA is not set
# CONFIG_NET_VENDOR_WIZNET is not set
# CONFIG_NET_VENDOR_XILINX is not set
CONFIG_PHYLIB=y
CONFIG_REALTEK_PHY=y
# CONFIG_USB_NET_DRIVERS is not set
# CONFIG_WLAN_VENDOR_ADMTEK is not set
CONFIG_ATH9K=m
# CONFIG_WLAN_VENDOR_ATMEL is not set
# CONFIG_WLAN_VENDOR_BROADCOM is not set
# CONFIG_WLAN_VENDOR_CISCO is not set
CONFIG_IWLWIFI=m
CONFIG_IWLDVM=m
CONFIG_IWLMVM=m
# CONFIG_WLAN_VENDOR_INTERSIL is not set
# CONFIG_WLAN_VENDOR_MARVELL is not set
CONFIG_MT7601U=m
# CONFIG_WLAN_VENDOR_RALINK is not set
CONFIG_RTL8192CU=m
# CONFIG_RTLWIFI_DEBUG is not set
CONFIG_RTL8XXXU=m
CONFIG_RTL8XXXU_UNTESTED=y
# CONFIG_WLAN_VENDOR_RSI is not set
# CONFIG_WLAN_VENDOR_ST is not set
# CONFIG_WLAN_VENDOR_TI is not set
# CONFIG_WLAN_VENDOR_ZYDAS is not set
# CONFIG_WLAN_VENDOR_QUANTENNA is not set
# CONFIG_INPUT_LEDS is not set
CONFIG_KEYBOARD_ATKBD=m
# CONFIG_INPUT_MOUSE is not set
CONFIG_SERIO=m
# CONFIG_LEGACY_PTYS is not set
CONFIG_SERIAL_8250=y
# CONFIG_SERIAL_8250_DEPRECATED_OPTIONS is not set
CONFIG_SERIAL_8250_CONSOLE=y
CONFIG_SERIAL_8250_NR_UARTS=2
CONFIG_SERIAL_8250_RUNTIME_UARTS=2
CONFIG_HW_RANDOM=y
CONFIG_HW_RANDOM_TIMERIOMEM=y
# CONFIG_HW_RANDOM_VIA is not set
CONFIG_NVRAM=y
CONFIG_HPET=y
# CONFIG_HPET_MMAP is not set
CONFIG_RANDOM_TRUST_CPU=y
CONFIG_RANDOM_TRUST_BOOTLOADER=y
CONFIG_I2C=y
# CONFIG_I2C_COMPAT is not set
CONFIG_PTP_1588_CLOCK=y
CONFIG_POWER_AVS=y
CONFIG_HWMON=m
CONFIG_THERMAL_WRITABLE_TRIPS=y
CONFIG_THERMAL_GOV_USER_SPACE=y
CONFIG_WATCHDOG=y
CONFIG_SSB=m
CONFIG_SSB_DRIVER_PCICORE=y
CONFIG_BCMA=m
CONFIG_MFD_INTEL_LPSS_ACPI=m
# CONFIG_VGA_ARB is not set
CONFIG_VGACON_SOFT_SCROLLBACK=y
CONFIG_SOUND=y
CONFIG_SND=y
CONFIG_SND_HRTIMER=y
# CONFIG_SND_SUPPORT_OLD_API is not set
CONFIG_SND_SEQUENCER=m
# CONFIG_SND_DRIVERS is not set
# CONFIG_SND_PCI is not set
CONFIG_SND_USB_AUDIO=m
# CONFIG_SND_X86 is not set
CONFIG_HIDRAW=y
CONFIG_USB_HIDDEV=y
CONFIG_USB=y
CONFIG_USB_ANNOUNCE_NEW_DEVICES=y
CONFIG_USB_MON=y
CONFIG_USB_XHCI_HCD=y
CONFIG_USB_EHCI_HCD=y
CONFIG_USB_EHCI_ROOT_HUB_TT=y
CONFIG_USB_OHCI_HCD=y
CONFIG_USB_STORAGE=y
CONFIG_USB_UAS=y
CONFIG_LEDS_TRIGGER_TIMER=m
CONFIG_LEDS_TRIGGER_HEARTBEAT=m
CONFIG_LEDS_TRIGGER_DEFAULT_ON=m
CONFIG_RTC_CLASS=y
CONFIG_DMADEVICES=y
# CONFIG_VIRTIO_MENU is not set
CONFIG_STAGING=y
CONFIG_R8712U=m
CONFIG_R8188EU=m
# CONFIG_X86_PLATFORM_DEVICES is not set
CONFIG_PM_DEVFREQ=y
CONFIG_DEVFREQ_GOV_PERFORMANCE=y
CONFIG_DEVFREQ_GOV_POWERSAVE=y
CONFIG_MEMORY=y
CONFIG_GENERIC_PHY=y
CONFIG_EXT4_FS=y
CONFIG_EXT4_FS_POSIX_ACL=y
CONFIG_EXT4_FS_SECURITY=y
CONFIG_FANOTIFY=y
CONFIG_AUTOFS_FS=y
CONFIG_FUSE_FS=y
CONFIG_ISO9660_FS=y
CONFIG_JOLIET=y
CONFIG_ZISOFS=y
CONFIG_UDF_FS=m
CONFIG_MSDOS_FS=y
CONFIG_VFAT_FS=y
CONFIG_NTFS_FS=y
CONFIG_NTFS_RW=y
CONFIG_TMPFS=y
CONFIG_TMPFS_POSIX_ACL=y
CONFIG_HUGETLBFS=y
CONFIG_SQUASHFS=y
CONFIG_SQUASHFS_XATTR=y
CONFIG_NFS_FS=y
CONFIG_NFS_V3_ACL=y
CONFIG_NFS_V4=y
CONFIG_NFS_V4_1=y
CONFIG_NFS_V4_2=y
CONFIG_NFS_V4_1_MIGRATION=y
CONFIG_CIFS=y
CONFIG_CIFS_WEAK_PW_HASH=y
CONFIG_CIFS_XATTR=y
CONFIG_CIFS_POSIX=y
# CONFIG_CIFS_DEBUG is not set
CONFIG_NLS_DEFAULT="utf8"
CONFIG_NLS_CODEPAGE_437=y
CONFIG_NLS_CODEPAGE_850=y
CONFIG_NLS_ASCII=y
CONFIG_NLS_ISO8859_1=y
CONFIG_NLS_UTF8=y
CONFIG_CRYPTO_PCRYPT=m
CONFIG_CRYPTO_AUTHENC=y
CONFIG_CRYPTO_ECHAINIV=y
CONFIG_CRYPTO_CBC=y
CONFIG_CRYPTO_CTS=m
CONFIG_CRYPTO_PCBC=m
CONFIG_CRYPTO_CRC32C_INTEL=m
CONFIG_CRYPTO_CRC32_PCLMUL=m
CONFIG_CRYPTO_POLY1305_X86_64=m
CONFIG_CRYPTO_SHA1=y
CONFIG_CRYPTO_SHA1_SSSE3=m
CONFIG_CRYPTO_SHA256_SSSE3=m
CONFIG_CRYPTO_SHA512_SSSE3=m
CONFIG_CRYPTO_AES_NI_INTEL=y
CONFIG_CRYPTO_DES=y
CONFIG_CRYPTO_DES3_EDE_X86_64=y
CONFIG_CRYPTO_TWOFISH_AVX_X86_64=y
CONFIG_CRYPTO_DEFLATE=y
CONFIG_CRYPTO_LZO=m
CONFIG_CRYPTO_842=m
CONFIG_CRYPTO_LZ4=m
CONFIG_CRYPTO_LZ4HC=m
CONFIG_CORDIC=m
CONFIG_CRC_CCITT=m
CONFIG_CRC_ITU_T=y
CONFIG_XZ_DEC=y
# CONFIG_XZ_DEC_POWERPC is not set
# CONFIG_XZ_DEC_ARM is not set
# CONFIG_XZ_DEC_ARMTHUMB is not set
# CONFIG_XZ_DEC_SPARC is not set
CONFIG_PRINTK_TIME=y
# CONFIG_ENABLE_MUST_CHECK is not set
CONFIG_STRIP_ASM_SYMS=y
CONFIG_MAGIC_SYSRQ=y
# CONFIG_DEBUG_MISC is not set
# CONFIG_SCHED_DEBUG is not set
# CONFIG_DEBUG_PREEMPT is not set
# CONFIG_DEBUG_BUGVERBOSE is not set
# CONFIG_FTRACE is not set
# CONFIG_RUNTIME_TESTING_MENU is not set
CONFIG_IO_STRICT_DEVMEM=y
# CONFIG_EARLY_PRINTK is not set
CONFIG_IO_DELAY_NONE=y
# CONFIG_X86_DEBUG_FPU is not set
CONFIG_UNWINDER_GUESS=y
```
